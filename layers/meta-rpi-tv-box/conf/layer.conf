## layers/meta-rpi-tv-box/conf/layer.conf
```bitbake
BBPATH .= ":${LAYERDIR}"
BBFILES += "${LAYERDIR}/recipes-*/*/*.bb \
            ${LAYERDIR}/recipes-*/*/*.bbappend"

BBFILE_COLLECTIONS += "rpi-tv-box"
BBFILE_PATTERN_rpi-tv-box := "^${LAYERDIR}/"
BBFILE_PRIORITY_rpi-tv-box = "99"
LAYERSERIES_COMPAT_rpi-tv-box = "langdale"
```
